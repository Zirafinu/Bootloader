
MEMORY
{
    RAM_TOTAL (xrw): ORIGIN = 0x00300000, LENGTH = 1M
}

MEMORY
{
    RAM_ACTIVE(rwx): ORIGIN = ORIGIN(RAM_TOTAL)                      , LENGTH = LENGTH(RAM_TOTAL) - 4
    SKIP_CODES (rw): ORIGIN = ORIGIN(RAM_ACTIVE) + LENGTH(RAM_ACTIVE), LENGTH = 4
}

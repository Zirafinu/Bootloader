REGION_ALIAS("RESET_FLASH", BASE_RAM)
REGION_ALIAS("FLASH", BASE_RAM)
REGION_ALIAS("FAST_DATA_RAM", BASE_RAM)
REGION_ALIAS("FAST_CODE_RAM", BASE_RAM)
REGION_ALIAS("STACK_RAM", BASE_RAM)
REGION_ALIAS("HEAP_RAM", BASE_RAM)
REGION_ALIAS("RAM", BASE_RAM)
REGION_ALIAS("SKIP_CODES", BASE_RAM)

ENTRY(_start)

SECTIONS
{
    /* initialize the minimal vector table */
    .ISR_VECTOR_QEMU_PATCH : ALIGN(512) {
        LONG(estack);
        LONG(_start+1);
    } > FLASH
}

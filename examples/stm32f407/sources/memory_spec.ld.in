MEMORY
{
    RAM_TOTAL (xrw)  : ORIGIN = 0x20000000, LENGTH = 128K
    CCMRAM (xrw)     : ORIGIN = 0x10000000, LENGTH = 64K
    FLASH_TOTAL (rx) : ORIGIN = ${total_begin},  LENGTH = ${total_size}
}

MEMORY {
    SKIP_CODES (rw): ORIGIN = ORIGIN(RAM_TOTAL),     LENGTH = 4
    RAM       (rwx): ORIGIN = ORIGIN(RAM_TOTAL) + 4, LENGTH = LENGTH(RAM_TOTAL) - 4

    FLASH_BOOTLOADER  (rx) : ORIGIN = ${bootl_begin}, LENGTH = ${bootl_size}
    FLASH_APPLICATION (rx) : ORIGIN = ${appli_begin}, LENGTH = ${appli_size}
    FLASH_UPDATE      (rx) : ORIGIN = ${updat_begin}, LENGTH = ${updat_size}
    FLASH_PARAMETER   (rx) : ORIGIN = ${param_begin}, LENGTH = ${param_size}
    FLASH_EVENT_LOG   (rx) : ORIGIN = ${event_begin}, LENGTH = ${event_size}
    FLASH_AUXILIARY   (rx) : ORIGIN = ${auxil_begin}, LENGTH = ${auxil_size}
}

estack = ORIGIN(RAM) + LENGTH(RAM);
application_skip_request = ORIGIN(SKIP_CODES);
application_entry_function = ORIGIN(FLASH_APPLICATION) + 4;

